## arch/arm/mach-s5l87xx/Kconfig
```kconfig
if ARCH_S5L87XX

choice
    prompt "S5L87XX board select"
    optional

config TARGET_NANO5G
    bool "Apple iPod Nano 5G"

config TARGET_NANO2G
    bool "Apple iPod Nano 2G"

endchoice

config SYS_SOC
    default "s5l87xx"

source "board/apple/nano5g/Kconfig"
source "board/apple/nano2g/Kconfig"

endif
```

## board/apple/nano2g/Kconfig
```kconfig
if TARGET_NANO2G

config SYS_BOARD
    default "nano2g"

config SYS_VENDOR
    default "apple"

config SYS_CONFIG_NAME
    default "applenano2g"

endif
```
